## hw/xtensa/Kconfig
```kconfig
config XTENSA_SIM
    bool

config XTENSA_VIRT
    bool
    select XTENSA_SIM
    select PCI_EXPRESS_GENERIC_BRIDGE
    select PCI_DEVICES

config XTENSA_XTFPGA
    bool
    select OPENCORES_ETH
    select PFLASH_CFI01
    select SERIAL

config XTENSA_INTEL_ADSP
    bool

config XTENSA_INTEL_ADSP_BYT
    bool

config XTENSA_INTEL_ADSP_HSW
    bool

config XTENSA_INTEL_ADSP_CAVS
    bool

config XTENSA_NXP_ADSP
    bool

config XTENSA_NXP_ADSP_IMX8
    bool

config XTENSA_NXP_ADSP_IMX8M
    bool

config XTENSA_MTK_ADSP
    bool

config XTENSA_MTK_ADSP_MT8195
    bool
```
